## CMakeLists.txt
```
cmake_minimum_required(VERSION 3.8.2)

set(CMAKE_EXPORT_COMPILE_COMMANDS TRUE)

set(CONF_FILE "prj.conf")

include($ENV{ZEPHYR_BASE}/cmake/app/boilerplate.cmake NO_POLICY_SCOPE)
project(si7021_test)

target_sources(app PRIVATE src/main.c)
```

## sample.yaml
```
sample:
  description: SI7021 driver test
    application
  name: si7021_test
  platforms: all
common:
    tags: introduction
    harness: console
    harness_config:
      type: one_line
      regex:
        - "si7021"
```

## prj.conf
```kconfig
CONFIG_GPIO=y
CONFIG_I2C=y
CONFIG_SENSOR=y
CONFIG_SI7021=y

CONFIG_SENSOR_LOG_LEVEL_DBG=y

CONFIG_LOG=y
CONFIG_LOG_BUFFER_SIZE=1024
CONFIG_LOG_BACKEND_SHOW_COLOR=y
```

## src/main.c
```c
/*
 * Copyright (c) 2012-2014 Wind River Systems, Inc.
 *
 * SPDX-License-Identifier: Apache-2.0
 */

#include <zephyr.h>
#include <misc/printk.h>

#include <sensor.h>

void main(void)
{
	struct sensor_value val;
	struct device *si7021;
	int err;

	printk("ZEPHYR Running on board %s\n", CONFIG_BOARD);

	si7021 = device_get_binding(CONFIG_SI7021_DEV_NAME);
	if(!si7021)
	{
		printk("Failed to get device %s\n", CONFIG_SI7021_DEV_NAME);

		return;
	}

	while(1)
	{
		k_sleep(500);

		err = sensor_sample_fetch(si7021);
		if(err)
		{
			printk("Failed to read sensor (err = %d)\n", err);
			continue;
		}

		err = sensor_channel_get(si7021, SENSOR_CHAN_HUMIDITY, &val);
		if(err == 0)
		{
			printk("Humidity: %d.%02d %%\n", val.val1, val.val2);
		}
		else
		{
			printk("Failed to get humidity (err = %d)\n", err);
		}

		err = sensor_channel_get(si7021, SENSOR_CHAN_AMBIENT_TEMP, &val);
		if(err == 0)
		{
			printk("Temperature: %d.%02d C\n", val.val1, val.val2);
		}
		else
		{
			printk("Failed to get temperature (err = %d)\n", err);
		}
	}
}
```
