## CMakeLists.txt
```
cmake_minimum_required(VERSION 3.8.2)

set(CMAKE_EXPORT_COMPILE_COMMANDS TRUE)

set(CONF_FILE "prj.conf")

include($ENV{ZEPHYR_BASE}/cmake/app/boilerplate.cmake NO_POLICY_SCOPE)
project(si1133_test)

target_sources(app PRIVATE src/main.c)
```

## sample.yaml
```
sample:
  description: SI1133 driver test
    application
  name: si1133_test
  platforms: all
common:
    tags: introduction
    harness: console
    harness_config:
      type: one_line
      regex:
        - "si1133"
```

## prj.conf
```kconfig
CONFIG_GPIO=y
CONFIG_I2C=y
CONFIG_SENSOR=y
CONFIG_SI1133=y

CONFIG_SENSOR_LOG_LEVEL_DBG=y

CONFIG_LOG=y
CONFIG_LOG_BUFFER_SIZE=1024
CONFIG_LOG_BACKEND_SHOW_COLOR=y
```

## src/main.c
```c
/*
 * Copyright (c) 2012-2014 Wind River Systems, Inc.
 *
 * SPDX-License-Identifier: Apache-2.0
 */

#include <zephyr.h>
#include <misc/printk.h>

#include <sensor.h>

void main(void)
{
	struct device *si1133;

	printk("ZEPHYR Running on board %s\n", CONFIG_BOARD);

	si1133 = device_get_binding(CONFIG_SI1133_DEV_NAME);
	if(!si1133)
	{
		printk("Failed to get device %s\n", CONFIG_SI1133_DEV_NAME);

		return;
	}

	while(1)
	{
		sensor_sample_fetch(si1133);

		k_sleep(1000);
	}
}
```
